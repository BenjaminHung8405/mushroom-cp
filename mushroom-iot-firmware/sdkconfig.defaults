## mushroom-iot-firmware/sdkconfig.defaults
```kconfig
# ESP-IDF bootloader settings for ESP32-S3 N16R8 OTA recovery.
CONFIG_FREERTOS_HZ=1000
CONFIG_AUTOSTART_ARDUINO=y
CONFIG_LITTLEFS_PAGE_SIZE=256
CONFIG_ESPTOOLPY_FLASHSIZE_2MB=n
CONFIG_ESPTOOLPY_FLASHSIZE_16MB=y
CONFIG_ESPTOOLPY_FLASHSIZE="16MB"
CONFIG_BOOTLOADER_APP_ROLLBACK_ENABLE=y

# Persist panic diagnostics for off-device extraction by the Orange Pi.
CONFIG_ESP_COREDUMP_ENABLE_TO_FLASH=y
CONFIG_ESP_COREDUMP_DATA_FORMAT_ELF=y
```
